## config/boards/shields/fifD4/Kconfig.defconfig
```kconfig
# Copyright (c) 2020 The ZMK Contributors
# SPDX-License-Identifier: MIT

if fifD4

config ZMK_KEYBOARD_NAME
    default "fifD4"

endif
```

## config/west.yml
```yaml
manifest:
  remotes:
    - name: zmkfirmware
      url-base: https://github.com/zmkfirmware
    - name: nmunnich
      url-base: https://github.com/nmunnich
  projects:
    - name: zmk-component-rp2040-zero
      remote: nmunnich
      revision: main
      import: app/west.yml
  self:
    path: config
```
